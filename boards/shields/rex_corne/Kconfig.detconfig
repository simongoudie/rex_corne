## boards/shields/rex_corne/Kconfig.detconfig
```kconfig
if SHIELD_REX_CORNE_LEFT

config ZMK_KEYBOARD_NAME
    default "Rex_Corne"

config ZMK_SPLIT_ROLE_CENTRAL
    default y

endif

if SHIELD_REX_CORNE_LEFT || SHIELD_REX_CORNE_RIGHT

config ZMK_SPLIT
    default y

if ZMK_BACKLIGHT

config PWM
    default y

config LED_PWM
    default y

endif
```

## boards/shields/rex_corne/Kconfig.shield
```kconfig
config SHIELD_REX_CORNE_LEFT
    def_bool $(shields_list_contains,rex_corne_left)

config SHIELD_REX_CORNE_RIGHT
    def_bool $(shields_list_contains,rex_corne_right)
```

## boards/shields/rex_corned/Kconfig.defconfig
```kconfig
if SHIELD_REX_CORNED_LEFT

config ZMK_KEYBOARD_NAME
    default "Rex_Corned"

config ZMK_SPLIT_BLE_ROLE_CENTRAL
    default y

config ZMK_USB
    default y

endif

if SHIELD_REX_CORNED_LEFT || SHIELD_REX_CORNED_RIGHT || SHIELD_REX_CORNED_DONGLE

config ZMK_SPLIT
    default y

config ZMK_BLE
    default y

config ZMK_DISPLAY
    default y

if ZMK_DISPLAY

config I2C
    default y

config SSD1306
    default y

endif # ZMK_DISPLAY

if LVGL

config LV_Z_VDB_SIZE
    default 64

config LV_DPI_DEF
    default 148

config LV_Z_BITS_PER_PIXEL
    default 1

choice LV_COLOR_DEPTH
    default LV_COLOR_DEPTH_1
endchoice

endif # LVGL

endif
```

## boards/shields/rex_corned/Kconfig.shield
```kconfig
config SHIELD_REX_CORNED_LEFT
    def_bool $(shields_list_contains,rex_corned_left)

config SHIELD_REX_CORNED_RIGHT
    def_bool $(shields_list_contains,rex_corned_right)
```
